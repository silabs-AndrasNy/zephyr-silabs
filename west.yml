## west.yml
```yaml
# Copyright 2024 Silicon Laboratories Inc.
# SPDX-License-Identifier: Apache-2.0

manifest:
  remotes:
    - name: zephyrproject-rtos
      url-base: https://github.com/zephyrproject-rtos
    - name: silabs
      url-base: https://github.com/siliconlabssoftware
    - name: evgenii
      url-base: git@github.com:kedMertens

  projects:
    - name: hal_silabs
      remote: silabs
      revision: 8d0e99a794f5b770afa4ea4eecb1b0fa0f918f4c
      path: modules/hal/silabs
    - name: zephyr-mbedtls
      remote: silabs
      revision: 6024c415bf050c09e3990bddb6d53d3b4990a2b1
      path: modules/crypto/mbedtls
    - name: zephyr
      remote: evgenii
      revision: e384c53d37532d780dbc3ca7d117851af0d8bfca
      import:
        # By using name-allowlist we can clone only the modules that are
        # strictly needed by the application.
        name-allowlist:
          - cmsis      # required by the ARM port
          - hal_silabs # required by Silabs boards
          - tinycrypt  # required e.g. by Bluetooth
```
